## west.yml
```yaml
manifest:
  self:
    path: app

  remotes:
    - name: nrfconnect
      url-base: https://github.com/nrfconnect

  projects:
    - name: nrf
      remote: nrfconnect
      repo-path: sdk-nrf
      revision: v2.3.0
      import:
        name-allowlist:
          - zephyr
          - hal_nordic
          - cmsis
          - mbedtls
          - mbedtls-nrf
          - nrfxlib
          - trusted-firmware-m
          - libmetal
          - liblc3
          - segger
          - tinycrypt
```
